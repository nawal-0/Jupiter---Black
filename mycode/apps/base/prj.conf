## CMakeLists.txt
```
cmake_minimum_required(VERSION 3.20.0)
find_package(Zephyr REQUIRED HINTS $ENV{ZEPHYR_BASE})
project(smart_badge)

target_sources(app PRIVATE src/main.c  ../../mylib/ble_receive.c ../../mylib/hci.c)
include_directories(app PRIVATE ~/csse4011/project/mycode/include)
```

## prj.conf
```kconfig
CONFIG_BT=y
CONFIG_BT_CENTRAL=y
CONFIG_BT_FILTER_ACCEPT_LIST=y
CONFIG_BT_SMP=y
CONFIG_BT_PERIPHERAL=y
CONFIG_BT_EXT_ADV=y
CONFIG_BT_PER_ADV=y
CONFIG_LOG=y
CONFIG_BT_DEVICE_NAME="Test Periodic Advertising"

CONFIG_STDOUT_CONSOLE=y
CONFIG_SENSOR=y
CONFIG_I2C=y
CONFIG_HEAP_MEM_POOL_SIZE=256
CONFIG_ASSERT=y
CONFIG_SHELL=y
CONFIG_USE_SEGGER_RTT=n
CONFIG_RTT_CONSOLE=n
CONFIG_UART_CONSOLE=y

CONFIG_I2C=y
CONFIG_I2C_LOG_LEVEL_DBG=y

CONFIG_SHELL=y
CONFIG_SHELL_BACKEND_RTT=n
CONFIG_STATS_SHELL=y
CONFIG_SHELL_ECHO_STATUS=y
CONFIG_DEVICE_SHELL=y
CONFIG_KERNEL_SHELL=y
```

## src/main.c
```c
#include <stdio.h>
#include <zephyr/kernel.h>
#include <zephyr/shell/shell.h>
#include <version.h>
#include <zephyr/logging/log.h>
#include <stdlib.h>
#include <zephyr/drivers/uart.h>
#include <zephyr/drivers/gpio.h>
#include <zephyr/usb/usb_device.h>
#include <ctype.h>
#include <stddef.h>
#include <zephyr/toolchain.h>
#include <zephyr/logging/log.h>
#include <zephyr/device.h>
#include <zephyr/sys/printk.h>
#include <zephyr/sys/__assert.h>
#include <string.h>

#include <zephyr/bluetooth/bluetooth.h>
#include <zephyr/bluetooth/hci.h>
#include <zephyr/bluetooth/conn.h>
#include <zephyr/bluetooth/uuid.h>
#include <zephyr/bluetooth/gatt.h>
#include <zephyr/sys/byteorder.h>

#include "time.h"
#include "hci.h"

#ifdef CONFIG_ARCH_POSIX
#include <unistd.h>
#else
#include <zephyr/posix/unistd.h>
#endif

LOG_MODULE_REGISTER(main);
/* 1000 msec = 1 sec */
#define SLEEP_TIME_MS 1000
#define STACKSIZE 1024
#define PRIORITY 7

// Register shell command
// SHELL_STATIC_SUBCMD_SET_CREATE(led_handler,
//                                SHELL_CMD_ARG(s, NULL, "Set led", cmd_set_led, 2, 0),
//                                SHELL_CMD_ARG(t, NULL, "Toggle led", cmd_toggle_led, 2, 0),
//                                SHELL_SUBCMD_SET_END /* Array terminated. dev_power on*/
// );
// SHELL_CMD_REGISTER(led, &led_handler, "LED handler", NULL);
// SHELL_CMD_REGISTER(time, NULL, "timer display", &cmd_time);
SHELL_CMD_REGISTER(mobile_addr, NULL, "register address", &cmd_reg_mobile);
SHELL_CMD_REGISTER(dev_power, NULL, "device power", &cmd_dev_power);
SHELL_CMD_REGISTER(send_weight, NULL, "send weight", &cmd_send_weight);
SHELL_CMD_REGISTER(speaker, NULL, "speaker", &cmd_speaker);
// SHELL_CMD_REGISTER(stop_energy, NULL, "send weight", &cmd_send_weight);
//   SHELL_CMD_REGISTER(view_node, NULL, "view node", &view_node);

// Register thread
// K_THREAD_DEFINE(led_id, STACKSIZE, thread_led, NULL, NULL, NULL,
//                 PRIORITY, 0, 0);
K_THREAD_DEFINE(send_id, STACKSIZE, tsk_ibeacon, NULL, NULL, NULL,
                PRIORITY, 0, 0);
// K_THREAD_DEFINE(receive_id, STACKSIZE, receive_data, NULL, NULL, NULL,
//                 PRIORITY, 0, 0);
K_THREAD_DEFINE(receive_id, STACKSIZE, tsk_scan, NULL, NULL, NULL,
                PRIORITY, 0, 0);
// K_THREAD_DEFINE(addr_id, STACKSIZE, reg_addr, NULL, NULL, NULL,
//                 PRIORITY, 0, 0);
```
