## CMakeLists.txt
```
# SPDX-License-Identifier: Apache-2.0

cmake_minimum_required(VERSION 3.20.0)
find_package(Zephyr REQUIRED HINTS $ENV{ZEPHYR_BASE})
project(smart_badge)

target_sources(app PRIVATE src/main.c  ../../mylib/ble_receive_mobile.c ../../mylib/motion_detect.c  ../../mylib/uart.c ../../mylib/sensors/lis2dh.c ../../mylib/speaker.c)
include_directories(app PRIVATE ~/csse4011/project/mycode/include)

# if(IBEACON_RSSI)
#   zephyr_compile_definitions(IBEACON_RSSI=${IBEACON_RSSI})
# endif()
```

## prj.conf
```kconfig
CONFIG_BT=y
CONFIG_BT_CENTRAL=y
CONFIG_BT_FILTER_ACCEPT_LIST=y
CONFIG_BT_SMP=y
CONFIG_BT_PERIPHERAL=y
CONFIG_BT_EXT_ADV=y
CONFIG_BT_PER_ADV=y
CONFIG_LOG=y
CONFIG_BT_DEVICE_NAME="Test Periodic Advertising"

CONFIG_STDOUT_CONSOLE=y
CONFIG_SENSOR=y
CONFIG_I2C=y
CONFIG_HEAP_MEM_POOL_SIZE=256
CONFIG_ASSERT=y
CONFIG_SHELL=y
CONFIG_USE_SEGGER_RTT=y
CONFIG_RTT_CONSOLE=y
CONFIG_UART_CONSOLE=n
# CONFIG_BT_CTLR_PRIVACY=n
# CONFIG_BT_PRIVACY=n
```

## src/main.c
```c
#include <stdio.h>
#include <zephyr/kernel.h>
#include <zephyr/drivers/gpio.h>
#include <zephyr/types.h>
#include <stddef.h>
#include <zephyr/sys/printk.h>
#include <zephyr/sys/util.h>

#include <zephyr/bluetooth/bluetooth.h>
#include <zephyr/bluetooth/hci.h>
#include "motion_detect.h"

#ifndef IBEACON_RSSI
#define IBEACON_RSSI 0xc8
#endif

#define PRIORITY 7
#define STACKSIZE 1024

// Register sensor sampling and ibeacon task
K_THREAD_DEFINE(ibeacon_id, STACKSIZE, tsk_ibeacon, NULL, NULL, NULL,
                PRIORITY, 0, 0);
K_THREAD_DEFINE(scan_id, STACKSIZE, tsk_scan, NULL, NULL, NULL,
                PRIORITY, 0, 0);
K_THREAD_DEFINE(sensor_id, STACKSIZE, tsk_sensor, NULL, NULL, NULL,
                PRIORITY, 0, 0);

int main(void)
{
    // speaker_activate();
    // k_msleep(1000);
    // speaker_deactivate();
    // return 0;
}
```
