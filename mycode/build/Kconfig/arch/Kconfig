## mycode/build/Kconfig/arch/Kconfig
```kconfig
# Load arch Kconfig descriptions.
osource "/home/narwhal/Jupiter-Black/zephyr/arch/x86/Kconfig"
osource "/home/narwhal/Jupiter-Black/zephyr/arch/xtensa/Kconfig"
osource "/home/narwhal/Jupiter-Black/zephyr/arch/sparc/Kconfig"
osource "/home/narwhal/Jupiter-Black/zephyr/arch/riscv/Kconfig"
osource "/home/narwhal/Jupiter-Black/zephyr/arch/posix/Kconfig"
osource "/home/narwhal/Jupiter-Black/zephyr/arch/nios2/Kconfig"
osource "/home/narwhal/Jupiter-Black/zephyr/arch/mips/Kconfig"
osource "/home/narwhal/Jupiter-Black/zephyr/arch/arm64/Kconfig"
osource "/home/narwhal/Jupiter-Black/zephyr/arch/arm/Kconfig"
osource "/home/narwhal/Jupiter-Black/zephyr/arch/arc/Kconfig"
```

## mycode/build/Kconfig/soc/Kconfig
```kconfig
# Load Zephyr SoC Kconfig descriptions.
osource "/root/csse4011/project/zephyr/soc/xlnx/zynqmp/Kconfig"
osource "/root/csse4011/project/zephyr/soc/xlnx/zynq7000/Kconfig"
osource "/root/csse4011/project/zephyr/soc/xen/Kconfig"
osource "/root/csse4011/project/zephyr/soc/ti/simplelink/Kconfig"
osource "/root/csse4011/project/zephyr/soc/ti/lm3s6965/Kconfig"
osource "/root/csse4011/project/zephyr/soc/ti/k3/Kconfig"
osource "/root/csse4011/project/zephyr/soc/telink/tlsr/Kconfig"
osource "/root/csse4011/project/zephyr/soc/starfive/jh71xx/Kconfig"
osource "/root/csse4011/project/zephyr/soc/st/stm32/Kconfig"
osource "/root/csse4011/project/zephyr/soc/snps/qemu_arc/Kconfig"
osource "/root/csse4011/project/zephyr/soc/snps/nsim/Kconfig"
osource "/root/csse4011/project/zephyr/soc/snps/hsdk4xd/Kconfig"
osource "/root/csse4011/project/zephyr/soc/snps/hsdk/Kconfig"
osource "/root/csse4011/project/zephyr/soc/snps/emsk/Kconfig"
osource "/root/csse4011/project/zephyr/soc/snps/emsdp/Kconfig"
osource "/root/csse4011/project/zephyr/soc/snps/arc_iot/Kconfig"
osource "/root/csse4011/project/zephyr/soc/silabs/Kconfig"
osource "/root/csse4011/project/zephyr/soc/sifive/sifive_freedom/Kconfig"
osource "/root/csse4011/project/zephyr/soc/rockchip/Kconfig"
osource "/root/csse4011/project/zephyr/soc/renode/riscv_virtual/Kconfig"
osource "/root/csse4011/project/zephyr/soc/renesas/smartbond/Kconfig"
osource "/root/csse4011/project/zephyr/soc/renesas/rzt2m/Kconfig"
osource "/root/csse4011/project/zephyr/soc/renesas/rcar/Kconfig"
osource "/root/csse4011/project/zephyr/soc/renesas/ra/Kconfig"
osource "/root/csse4011/project/zephyr/soc/raspberrypi/Kconfig"
osource "/root/csse4011/project/zephyr/soc/quicklogic/eos_s3/Kconfig"
osource "/root/csse4011/project/zephyr/soc/qemu/virt_riscv/Kconfig"
osource "/root/csse4011/project/zephyr/soc/qemu/malta/Kconfig"
osource "/root/csse4011/project/zephyr/soc/openisa/rv32m1/Kconfig"
osource "/root/csse4011/project/zephyr/soc/nxp/s32/Kconfig"
osource "/root/csse4011/project/zephyr/soc/nxp/rw/Kconfig"
osource "/root/csse4011/project/zephyr/soc/nxp/mcx/Kconfig"
osource "/root/csse4011/project/zephyr/soc/nxp/lpc/Kconfig"
osource "/root/csse4011/project/zephyr/soc/nxp/layerscape/Kconfig"
osource "/root/csse4011/project/zephyr/soc/nxp/kinetis/Kconfig"
osource "/root/csse4011/project/zephyr/soc/nxp/imxrt/Kconfig"
osource "/root/csse4011/project/zephyr/soc/nxp/imx/Kconfig"
osource "/root/csse4011/project/zephyr/soc/nuvoton/numicro/Kconfig"
osource "/root/csse4011/project/zephyr/soc/nuvoton/numaker/Kconfig"
osource "/root/csse4011/project/zephyr/soc/nuvoton/npcx/Kconfig"
osource "/root/csse4011/project/zephyr/soc/nordic/Kconfig"
osource "/root/csse4011/project/zephyr/soc/neorv32/Kconfig"
osource "/root/csse4011/project/zephyr/soc/native/inf_clock/Kconfig"
osource "/root/csse4011/project/zephyr/soc/microchip/miv/Kconfig"
osource "/root/csse4011/project/zephyr/soc/microchip/mec/Kconfig"
osource "/root/csse4011/project/zephyr/soc/lowrisc/opentitan/Kconfig"
osource "/root/csse4011/project/zephyr/soc/litex/litex_vexriscv/Kconfig"
osource "/root/csse4011/project/zephyr/soc/ite/ec/Kconfig"
osource "/root/csse4011/project/zephyr/soc/intel/raptor_lake/Kconfig"
osource "/root/csse4011/project/zephyr/soc/intel/lakemont/Kconfig"
osource "/root/csse4011/project/zephyr/soc/intel/intel_socfpga_std/Kconfig"
osource "/root/csse4011/project/zephyr/soc/intel/intel_socfpga/Kconfig"
osource "/root/csse4011/project/zephyr/soc/intel/intel_niosv/Kconfig"
osource "/root/csse4011/project/zephyr/soc/intel/intel_ish/Kconfig"
osource "/root/csse4011/project/zephyr/soc/intel/intel_adsp/Kconfig"
osource "/root/csse4011/project/zephyr/soc/intel/elkhart_lake/Kconfig"
osource "/root/csse4011/project/zephyr/soc/intel/atom/Kconfig"
osource "/root/csse4011/project/zephyr/soc/intel/apollo_lake/Kconfig"
osource "/root/csse4011/project/zephyr/soc/intel/alder_lake/Kconfig"
osource "/root/csse4011/project/zephyr/soc/infineon/xmc/Kconfig"
osource "/root/csse4011/project/zephyr/soc/gd/gd32/Kconfig"
osource "/root/csse4011/project/zephyr/soc/gaisler/leon3/Kconfig"
osource "/root/csse4011/project/zephyr/soc/gaisler/gr716a/Kconfig"
osource "/root/csse4011/project/zephyr/soc/espressif/Kconfig"
osource "/root/csse4011/project/zephyr/soc/ene/kb1200/Kconfig"
osource "/root/csse4011/project/zephyr/soc/efinix/sapphire/Kconfig"
osource "/root/csse4011/project/zephyr/soc/cypress/Kconfig"
osource "/root/csse4011/project/zephyr/soc/cdns/xtensa_sample_controller/Kconfig"
osource "/root/csse4011/project/zephyr/soc/cdns/dc233c/Kconfig"
osource "/root/csse4011/project/zephyr/soc/brcm/bcmvk/Kconfig"
osource "/root/csse4011/project/zephyr/soc/brcm/bcm2711/Kconfig"
osource "/root/csse4011/project/zephyr/soc/atmel/sam0/Kconfig"
osource "/root/csse4011/project/zephyr/soc/atmel/sam/Kconfig"
osource "/root/csse4011/project/zephyr/soc/aspeed/Kconfig"
osource "/root/csse4011/project/zephyr/soc/arm/Kconfig"
osource "/root/csse4011/project/zephyr/soc/arm/beetle/Kconfig"
osource "/root/csse4011/project/zephyr/soc/andestech/Kconfig"
osource "/root/csse4011/project/zephyr/soc/ambiq/Kconfig"
osource "/root/csse4011/project/zephyr/soc/altr/zephyr_nios2f/Kconfig"
osource "/root/csse4011/project/zephyr/soc/altr/qemu_nios2/Kconfig"
```

## mycode/build/Kconfig/soc/Kconfig.defconfig
```kconfig
# Load Zephyr SoC Kconfig defconfig.
osource "/root/csse4011/project/zephyr/soc/xlnx/zynqmp/Kconfig.defconfig"
osource "/root/csse4011/project/zephyr/soc/xlnx/zynq7000/Kconfig.defconfig"
osource "/root/csse4011/project/zephyr/soc/xen/Kconfig.defconfig"
osource "/root/csse4011/project/zephyr/soc/ti/simplelink/Kconfig.defconfig"
osource "/root/csse4011/project/zephyr/soc/ti/lm3s6965/Kconfig.defconfig"
osource "/root/csse4011/project/zephyr/soc/ti/k3/Kconfig.defconfig"
osource "/root/csse4011/project/zephyr/soc/telink/tlsr/Kconfig.defconfig"
osource "/root/csse4011/project/zephyr/soc/starfive/jh71xx/Kconfig.defconfig"
osource "/root/csse4011/project/zephyr/soc/st/stm32/Kconfig.defconfig"
osource "/root/csse4011/project/zephyr/soc/snps/qemu_arc/Kconfig.defconfig"
osource "/root/csse4011/project/zephyr/soc/snps/nsim/Kconfig.defconfig"
osource "/root/csse4011/project/zephyr/soc/snps/hsdk4xd/Kconfig.defconfig"
osource "/root/csse4011/project/zephyr/soc/snps/hsdk/Kconfig.defconfig"
osource "/root/csse4011/project/zephyr/soc/snps/emsk/Kconfig.defconfig"
osource "/root/csse4011/project/zephyr/soc/snps/emsdp/Kconfig.defconfig"
osource "/root/csse4011/project/zephyr/soc/snps/arc_iot/Kconfig.defconfig"
osource "/root/csse4011/project/zephyr/soc/silabs/Kconfig.defconfig"
osource "/root/csse4011/project/zephyr/soc/sifive/sifive_freedom/Kconfig.defconfig"
osource "/root/csse4011/project/zephyr/soc/rockchip/Kconfig.defconfig"
osource "/root/csse4011/project/zephyr/soc/renode/riscv_virtual/Kconfig.defconfig"
osource "/root/csse4011/project/zephyr/soc/renesas/smartbond/Kconfig.defconfig"
osource "/root/csse4011/project/zephyr/soc/renesas/rzt2m/Kconfig.defconfig"
osource "/root/csse4011/project/zephyr/soc/renesas/rcar/Kconfig.defconfig"
osource "/root/csse4011/project/zephyr/soc/renesas/ra/Kconfig.defconfig"
osource "/root/csse4011/project/zephyr/soc/raspberrypi/Kconfig.defconfig"
osource "/root/csse4011/project/zephyr/soc/quicklogic/eos_s3/Kconfig.defconfig"
osource "/root/csse4011/project/zephyr/soc/qemu/virt_riscv/Kconfig.defconfig"
osource "/root/csse4011/project/zephyr/soc/qemu/malta/Kconfig.defconfig"
osource "/root/csse4011/project/zephyr/soc/openisa/rv32m1/Kconfig.defconfig"
osource "/root/csse4011/project/zephyr/soc/nxp/s32/Kconfig.defconfig"
osource "/root/csse4011/project/zephyr/soc/nxp/rw/Kconfig.defconfig"
osource "/root/csse4011/project/zephyr/soc/nxp/mcx/Kconfig.defconfig"
osource "/root/csse4011/project/zephyr/soc/nxp/lpc/Kconfig.defconfig"
osource "/root/csse4011/project/zephyr/soc/nxp/layerscape/Kconfig.defconfig"
osource "/root/csse4011/project/zephyr/soc/nxp/kinetis/Kconfig.defconfig"
osource "/root/csse4011/project/zephyr/soc/nxp/imxrt/Kconfig.defconfig"
osource "/root/csse4011/project/zephyr/soc/nxp/imx/Kconfig.defconfig"
osource "/root/csse4011/project/zephyr/soc/nuvoton/numicro/Kconfig.defconfig"
osource "/root/csse4011/project/zephyr/soc/nuvoton/numaker/Kconfig.defconfig"
osource "/root/csse4011/project/zephyr/soc/nuvoton/npcx/Kconfig.defconfig"
osource "/root/csse4011/project/zephyr/soc/nordic/Kconfig.defconfig"
osource "/root/csse4011/project/zephyr/soc/neorv32/Kconfig.defconfig"
osource "/root/csse4011/project/zephyr/soc/native/inf_clock/Kconfig.defconfig"
osource "/root/csse4011/project/zephyr/soc/microchip/miv/Kconfig.defconfig"
osource "/root/csse4011/project/zephyr/soc/microchip/mec/Kconfig.defconfig"
osource "/root/csse4011/project/zephyr/soc/lowrisc/opentitan/Kconfig.defconfig"
osource "/root/csse4011/project/zephyr/soc/litex/litex_vexriscv/Kconfig.defconfig"
osource "/root/csse4011/project/zephyr/soc/ite/ec/Kconfig.defconfig"
osource "/root/csse4011/project/zephyr/soc/intel/raptor_lake/Kconfig.defconfig"
osource "/root/csse4011/project/zephyr/soc/intel/lakemont/Kconfig.defconfig"
osource "/root/csse4011/project/zephyr/soc/intel/intel_socfpga_std/Kconfig.defconfig"
osource "/root/csse4011/project/zephyr/soc/intel/intel_socfpga/Kconfig.defconfig"
osource "/root/csse4011/project/zephyr/soc/intel/intel_niosv/Kconfig.defconfig"
osource "/root/csse4011/project/zephyr/soc/intel/intel_ish/Kconfig.defconfig"
osource "/root/csse4011/project/zephyr/soc/intel/intel_adsp/Kconfig.defconfig"
osource "/root/csse4011/project/zephyr/soc/intel/elkhart_lake/Kconfig.defconfig"
osource "/root/csse4011/project/zephyr/soc/intel/atom/Kconfig.defconfig"
osource "/root/csse4011/project/zephyr/soc/intel/apollo_lake/Kconfig.defconfig"
osource "/root/csse4011/project/zephyr/soc/intel/alder_lake/Kconfig.defconfig"
osource "/root/csse4011/project/zephyr/soc/infineon/xmc/Kconfig.defconfig"
osource "/root/csse4011/project/zephyr/soc/gd/gd32/Kconfig.defconfig"
osource "/root/csse4011/project/zephyr/soc/gaisler/leon3/Kconfig.defconfig"
osource "/root/csse4011/project/zephyr/soc/gaisler/gr716a/Kconfig.defconfig"
osource "/root/csse4011/project/zephyr/soc/espressif/Kconfig.defconfig"
osource "/root/csse4011/project/zephyr/soc/ene/kb1200/Kconfig.defconfig"
osource "/root/csse4011/project/zephyr/soc/efinix/sapphire/Kconfig.defconfig"
osource "/root/csse4011/project/zephyr/soc/cypress/Kconfig.defconfig"
osource "/root/csse4011/project/zephyr/soc/cdns/xtensa_sample_controller/Kconfig.defconfig"
osource "/root/csse4011/project/zephyr/soc/cdns/dc233c/Kconfig.defconfig"
osource "/root/csse4011/project/zephyr/soc/brcm/bcmvk/Kconfig.defconfig"
osource "/root/csse4011/project/zephyr/soc/brcm/bcm2711/Kconfig.defconfig"
osource "/root/csse4011/project/zephyr/soc/atmel/sam0/Kconfig.defconfig"
osource "/root/csse4011/project/zephyr/soc/atmel/sam/Kconfig.defconfig"
osource "/root/csse4011/project/zephyr/soc/aspeed/Kconfig.defconfig"
osource "/root/csse4011/project/zephyr/soc/arm/Kconfig.defconfig"
osource "/root/csse4011/project/zephyr/soc/arm/beetle/Kconfig.defconfig"
osource "/root/csse4011/project/zephyr/soc/andestech/Kconfig.defconfig"
osource "/root/csse4011/project/zephyr/soc/ambiq/Kconfig.defconfig"
osource "/root/csse4011/project/zephyr/soc/altr/zephyr_nios2f/Kconfig.defconfig"
osource "/root/csse4011/project/zephyr/soc/altr/qemu_nios2/Kconfig.defconfig"
```
